## build/nrf5340dk/nrf5340/cpuapp/Kconfig/Kconfig.modules
```kconfig
menu "cmsis_6 (C:/Projects/Github/LoRa_Radio/external/modules/hal/cmsis_6)"
osource "$(ZEPHYR_CMSIS_6_KCONFIG)"
config ZEPHYR_CMSIS_6_MODULE
	bool
	default y
endmenu
menu "hal_espressif (C:/Projects/Github/LoRa_Radio/external/modules/hal/espressif)"
osource "C:/Projects/Github/LoRa_Radio/external/modules/hal/espressif/zephyr/Kconfig"
config ZEPHYR_HAL_ESPRESSIF_MODULE
	bool
	default y

config ZEPHYR_HAL_ESPRESSIF_MODULE_BLOBS
	bool
endmenu
menu "hal_nordic (C:/Projects/Github/LoRa_Radio/external/modules/hal/nordic)"
osource "$(ZEPHYR_HAL_NORDIC_KCONFIG)"
config ZEPHYR_HAL_NORDIC_MODULE
	bool
	default y

config ZEPHYR_HAL_NORDIC_MODULE_BLOBS
	bool
endmenu
config ZEPHYR_XTENSA_MODULE
	bool
	default y
menu "loramac-node (C:/Projects/Github/LoRa_Radio/external/modules/lib/loramac-node)"
osource "$(ZEPHYR_LORAMAC_NODE_KCONFIG)"
config ZEPHYR_LORAMAC_NODE_MODULE
	bool
	default y
endmenu
menu "picolibc (C:/Projects/Github/LoRa_Radio/external/modules/lib/picolibc)"
osource "C:/Projects/Github/LoRa_Radio/external/modules/lib/picolibc/zephyr/Kconfig"
config ZEPHYR_PICOLIBC_MODULE
	bool
	default y
endmenu
menu "segger (C:/Projects/Github/LoRa_Radio/external/modules/debug/segger)"
osource "$(ZEPHYR_SEGGER_KCONFIG)"
config ZEPHYR_SEGGER_MODULE
	bool
	default y
endmenu
```

## build/nrf5340dk/nrf5340/cpuapp/Kconfig/Kconfig.shield.defconfig
```kconfig
osource "c:\Projects\Github\LoRa_Radio\external\zephyr/boards/shields/*/Kconfig.defconfig"
```

## build/nrf5340dk/nrf5340/cpuapp/Kconfig/Kconfig.sysbuild.modules
```kconfig
config ZEPHYR_CMSIS_6_MODULE
   bool
   default y
config ZEPHYR_HAL_ESPRESSIF_MODULE
   bool
   default y
config ZEPHYR_HAL_NORDIC_MODULE
   bool
   default y
config ZEPHYR_XTENSA_MODULE
   bool
   default y
config ZEPHYR_PICOLIBC_MODULE
   bool
   default y
config ZEPHYR_SEGGER_MODULE
   bool
   default y
```

## build/nrf5340dk/nrf5340/cpuapp/Kconfig/arch/Kconfig
```kconfig
# Load Zephyr Arch Kconfig descriptions.
osource "C:/Projects/Github/LoRa_Radio/external/zephyr/arch/rx/Kconfig"
osource "C:/Projects/Github/LoRa_Radio/external/zephyr/arch/x86/Kconfig"
osource "C:/Projects/Github/LoRa_Radio/external/zephyr/arch/xtensa/Kconfig"
osource "C:/Projects/Github/LoRa_Radio/external/zephyr/arch/sparc/Kconfig"
osource "C:/Projects/Github/LoRa_Radio/external/zephyr/arch/riscv/Kconfig"
osource "C:/Projects/Github/LoRa_Radio/external/zephyr/arch/posix/Kconfig"
osource "C:/Projects/Github/LoRa_Radio/external/zephyr/arch/mips/Kconfig"
osource "C:/Projects/Github/LoRa_Radio/external/zephyr/arch/arm64/Kconfig"
osource "C:/Projects/Github/LoRa_Radio/external/zephyr/arch/arm/Kconfig"
osource "C:/Projects/Github/LoRa_Radio/external/zephyr/arch/arc/Kconfig"
```

## build/nrf5340dk/nrf5340/cpuapp/Kconfig/boards/Kconfig
```kconfig
# Load Zephyr board Kconfig descriptions.
osource "C:/Projects/Github/LoRa_Radio/external/zephyr/boards/nordic/nrf5340dk/Kconfig"
```

## build/nrf5340dk/nrf5340/cpuapp/Kconfig/boards/Kconfig.defconfig
```kconfig
# Load Zephyr board defconfig descriptions.
osource "C:/Projects/Github/LoRa_Radio/external/zephyr/boards/nordic/nrf5340dk/Kconfig.defconfig"
```

## build/nrf5340dk/nrf5340/cpuapp/Kconfig/boards/Kconfig.nrf5340dk
```kconfig
# Load board Kconfig descriptions.
osource "C:/Projects/Github/LoRa_Radio/external/zephyr/boards/nordic/nrf5340dk/Kconfig.nrf5340dk"
```

## build/nrf5340dk/nrf5340/cpuapp/Kconfig/boards/Kconfig.sysbuild
```kconfig
# Load Sysbuild board Kconfig descriptions.
osource "C:/Projects/Github/LoRa_Radio/external/zephyr/boards/nordic/nrf5340dk/Kconfig.sysbuild"
```
